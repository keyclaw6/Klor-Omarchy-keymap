## zmk-single-wire/config/west.yml
```yaml
manifest:
  remotes:
    - name: zmkfirmware
      url-base: https://github.com/zmkfirmware
  projects:
    - name: zmk
      remote: zmkfirmware
      revision: 9ebbeff0a8b69a42f14aec022cdf16c7a107b9e0
      import: app/west.yml
  self:
    path: config
```

## zmk/config/west.yml
```yaml
manifest:
  remotes:
    - name: zmk-single-wire
      url-base: https://github.com/keyclaw6
  projects:
    - name: zmk
      remote: zmk-single-wire
      repo-path: zz-scratch-probe-20260902
      revision: feature/single-wire-wired-split
      import: app/west.yml
  self:
    path: config
```

## zmk/module/Kconfig
```kconfig
menuconfig KLOR_OMARCHY
    bool "KLOR Omarchy custom firmware support"
    default y

if KLOR_OMARCHY

config KLOR_OMARCHY_RAW_HID
    bool "QMK-compatible KLOR bridge Raw HID interface"
    default y if ZMK_USB
    depends on ZMK_USB && (!ZMK_SPLIT || ZMK_SPLIT_ROLE_CENTRAL)
    select USB_DEVICE_HID

endif
```

## zmk/module/dts/bindings/behaviors/klor,behavior-control.yaml
```yaml
description: KLOR Omarchy stateful control behavior

compatible: "klor,behavior-control"

include: two_param.yaml

properties:
  nav-layer:
    type: int
    required: true
  command-timeout-ms:
    type: int
    default: 3000
  ralt-tap-window-ms:
    type: int
    default: 350
  stt-tap-window-ms:
    type: int
    default: 300
```

## zmk/module/dts/bindings/behaviors/klor,behavior-unicode.yaml
```yaml
description: Linux Unicode entry with QMK-compatible Shift/Caps Lock pairs
compatible: "klor,behavior-unicode"
include: two_param.yaml
```
